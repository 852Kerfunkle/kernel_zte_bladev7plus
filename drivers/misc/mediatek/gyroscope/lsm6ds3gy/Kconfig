## drivers/misc/mediatek/gyroscope/lsm6ds3gy/Kconfig
```kconfig
config MTK_LSM6DS3

	bool "LSM6DS3 for MediaTek package"
	default n
	help
	  It support different gyro sensor.
          If this option is set,
	  it will support
          LSM6DS3 gyro.
```

## drivers/spi/mediatek/Kconfig
```kconfig
#SPI
config MTK_SPI
	tristate "MediaTek SPI controller"
	#depends on SPI
	default n
	---help---
	This selects the MediaTek(R) SPI bus driver.
	If you want to use MediaTek(R) SPI interface, say Y or M here.  If unsure, say N.

config FINGERPRINT_GF3208
	bool "gf3208"
	depends on INPUT
	help
	Select this option to support goodix fingerprint chip gf311x
	chip int.  
```
